#include <dt-bindings/zmk/input_transform.h>
#include <input/processors.dtsi>

#define BASE 0
#define NAV 1
#define MEDIA 2
#define Game 3
#define Gameq 4
#define MOUSE 5

/ {
  split_inputs {
    #address-cells = <1>;
    #size-cells = <0>;

    trackball_split: trackball_split@0 {
      compatible = "zmk,input-split";
      reg = <0>;
    };
  };

  trackball_listener: trackball_listener {
    compatible = "zmk,input-listener";
    status = "okay";
    device = <&trackball_split>;
    layers = <0 1 2 3 4 5>;
    input-processors = <&zip_xy_scaler 3 1>;
    };

    snipe {
      layers = <5>;
      input-processors = <&zip_xy_scaler 1 6>;
    };

    scroll {
      layers = <2>;
      input-processors = <&zip_xy_transform (INPUT_TRANSFORM_Y_INVERT)>, <&zip_xy_scaler 1 5>, <&zip_xy_to_scroll_mapper>;
    };
  };
};
